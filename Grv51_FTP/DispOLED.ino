/*
 * ATmegaDetonator - Escrita no display OLED
 * 
 * (C) 2020-2021, Daniel Quadros
 */

// Comandos
#define SSD1306_SETCONTRAST 0x81
#define SSD1306_DISPLAYALLON_RESUME 0xA4
#define SSD1306_DISPLAYALLON 0xA5
#define SSD1306_NORMALDISPLAY 0xA6
#define SSD1306_INVERTDISPLAY 0xA7
#define SSD1306_DISPLAYOFF 0xAE
#define SSD1306_DISPLAYON 0xAF
#define SSD1306_SETDISPLAYOFFSET 0xD3
#define SSD1306_SETCOMPINS 0xDA
#define SSD1306_SETVCOMDETECT 0xDB
#define SSD1306_SETDISPLAYCLOCKDIV 0xD5
#define SSD1306_SETPRECHARGE 0xD9
#define SSD1306_SETMULTIPLEX 0xA8
#define SSD1306_SETLOWCOLUMN 0x00
#define SSD1306_SETHIGHCOLUMN 0x10
#define SSD1306_SETSTARTLINE 0x40
#define SSD1306_MEMORYMODE 0x20
#define SSD1306_COLUMNADDR 0x21
#define SSD1306_PAGEADDR   0x22
#define SSD1306_COMSCANINC 0xC0
#define SSD1306_COMSCANDEC 0xC8
#define SSD1306_SEGREMAP 0xA0
#define SSD1306_CHARGEPUMP 0x8D
#define SSD1306_EXTERNALVCC 0x1
#define SSD1306_SWITCHCAPVCC 0x2

// Tamanho da tela
#define SSD1306_LCDWIDTH                  128
#define SSD1306_LCDHEIGHT                 64

// Sequência de iniciação do display
byte cmdInit[] =
{
    SSD1306_DISPLAYOFF,
    SSD1306_SETDISPLAYCLOCKDIV, 0x80,
    SSD1306_SETMULTIPLEX, 0x3F,
    SSD1306_SETDISPLAYOFFSET, 0x00,
    SSD1306_SETSTARTLINE | 0x0,
    SSD1306_CHARGEPUMP, 0x14,
    SSD1306_MEMORYMODE, 0x00,
    SSD1306_SEGREMAP | 0x1,
    SSD1306_COMSCANDEC,
    SSD1306_SETCOMPINS, 0x12,
    SSD1306_SETCONTRAST, 0xCF,
    SSD1306_SETPRECHARGE, 0xF1,
    SSD1306_SETVCOMDETECT, 0x40,
    SSD1306_DISPLAYALLON_RESUME,
    SSD1306_NORMALDISPLAY,
    SSD1306_DISPLAYON
};

const uint8_t hexa[] = "0123456789ABCDEF";

/**
 * ssd1306xled_font8x16 is by Neven Boyanov
 *
 * @created: 2014-08-12
 * @author: Neven Boyanov
 *
 * Copyright (c) 2015 Neven Boyanov, Tinusaur Team. All Rights Reserved.
 * Distributed as open source software under MIT License, see LICENSE.txt file.
 * Please, as a favour, retain the link http://tinusaur.org to The Tinusaur Project.
 *
 * Source code available at: https://bitbucket.org/tinusaur/ssd1306xled
 *
 */
const uint8_t font8x16 []=
{
    0x00, 0x00, 0x00, 0x00, 0x00, 0x00, 0x00, 0x00, 0x00, 0x00, 0x00, 0x00, 0x00, 0x00, 0x00, 0x00, //   0
    0x00, 0x00, 0x00, 0xF8, 0x00, 0x00, 0x00, 0x00, 0x00, 0x00, 0x00, 0x33, 0x30, 0x00, 0x00, 0x00, // ! 1
    0x00, 0x10, 0x0C, 0x06, 0x10, 0x0C, 0x06, 0x00, 0x00, 0x00, 0x00, 0x00, 0x00, 0x00, 0x00, 0x00, // " 2
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    0x40, 0x40, 0x80, 0xF0, 0x80, 0x40, 0x40, 0x00, 0x02, 0x02, 0x01, 0x0F, 0x01, 0x02, 0x02, 0x00  //   95
};

// Iniciação do display
void Display_init()
{
  Display_sendcmd (cmdInit, sizeof(cmdInit));
  Display_clear();
}

// Limpa o display
void Display_clear()
{
  // Define endereços iniciais e finais de colunas e páginas
  Display_sendcmd (SSD1306_COLUMNADDR);
  Display_sendcmd (0);
  Display_sendcmd (SSD1306_LCDWIDTH-1);
  Display_sendcmd (SSD1306_PAGEADDR);
  Display_sendcmd (0);
  Display_sendcmd (7);

  // Preenche a memória com zeros
  for (uint16_t i=0; i<(SSD1306_LCDWIDTH*SSD1306_LCDHEIGHT/8/16); i++) 
  {
      Wire.beginTransmission(DISP_Addr);
      Wire.write(0x40);  // Co=0, DC = 1
      for (uint8_t x=0; x<16; x++) 
      {
          Wire.write(0);
      }
      Wire.endTransmission();
  }
}

// Limpa a linha l(0 a 3)
void Display_clearline (byte l) {
  // Define endereços iniciais e finais de colunas e páginas
  Display_sendcmd (SSD1306_COLUMNADDR);
  Display_sendcmd (0);
  Display_sendcmd (SSD1306_LCDWIDTH-1);
  Display_sendcmd (SSD1306_PAGEADDR);
  Display_sendcmd (2*l);
  Display_sendcmd (2*l+1);

  // Preenche a memória com zeros
  for (uint16_t i=0; i<((SSD1306_LCDWIDTH*2)/16); i++) 
  {
      Wire.beginTransmission(DISP_Addr);
      Wire.write(0x40);  // Co=0, DC = 1
      for (uint8_t x=0; x<16; x++) 
      {
          Wire.write(0);
      }
      Wire.endTransmission();
  }
}

// Escreve um valor hexa a partir da linha l(0 a 3), coluna c(0 a 15)
void Display_writehex (byte l, byte c, byte valor) {
  Display_write (l, c, pgm_read_byte(&hexa[valor >> 4]), VID_NORMAL);
  Display_write (l, c+1, pgm_read_byte(&hexa[valor & 0x0F]), VID_NORMAL);
}


// Escreve um string a partir da linha l(0 a 3), coluna c(0 a 15)
void Display_print (byte l, byte c, char *str, byte rev) {
  while (*str != 0) {
    Display_write (l, c, *str, rev);
    if (++c == 16) {
      c = 0;
      if (++l == 4) {
        l = 0;
      }
    }
    str++;
  }
}

// Escreve um caracter na linha l(0 a 3), coluna c(0 a 15)
void Display_write (byte l, byte c, byte car, byte rev) {
  if ((car < 0x20) || (car > 0x7F)) {
    car = 0x20;
  }
  car -= 0x20;
  uint8_t *gc = (uint8_t *) &font8x16[car*16];

  // Endereça e escreve a parte de cima
  Display_sendcmd (SSD1306_COLUMNADDR);
  Display_sendcmd (c << 3);
  Display_sendcmd ((c << 3) + 7);
  Display_sendcmd (SSD1306_PAGEADDR);
  Display_sendcmd (l << 1);
  Display_sendcmd (l << 1);
  Wire.beginTransmission(DISP_Addr);
  Wire.write(0x40);  // Co=0, DC = 1
  for (uint8_t x = 0;  x < 8; x++) 
  {
      Wire.write(pgm_read_byte(gc++) ^ rev);
  }
  Wire.endTransmission();

  // Endereça e escreve a parte de baixo
  Display_sendcmd (SSD1306_COLUMNADDR);
  Display_sendcmd (c << 3);
  Display_sendcmd ((c << 3) + 7);
  Display_sendcmd (SSD1306_PAGEADDR);
  Display_sendcmd ((l << 1) + 1);
  Display_sendcmd ((l << 1) + 1);
  Wire.beginTransmission(DISP_Addr);
  Wire.write(0x40);  // Co=0, DC = 1
  for (uint8_t x = 0;  x < 8; x++) 
  {
      Wire.write(pgm_read_byte(gc++) ^rev);
  }
  Wire.endTransmission();
}

// Envia sequência de comandos ao display
void Display_sendcmd (byte *cmd, int nCmds)
{
  Wire.beginTransmission(DISP_Addr);
  Wire.write (0);  // Co= 0. DC = 0
  for (int i = 0; i < nCmds; i++)
  {
    Wire.write(cmd[i]);
  }
  Wire.endTransmission();
}

// Envia um byte de comando ao display
void Display_sendcmd (byte cmd)
{
  Wire.beginTransmission(DISP_Addr);
  Wire.write (0);  // Co= 0. DC = 0
  Wire.write(cmd);
  Wire.endTransmission();
}